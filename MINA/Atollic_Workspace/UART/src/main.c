/*
******************************************************************************
File:     main.c
Info:     Generated by Atollic TrueSTUDIO(R) 8.0.0   2017-09-26

The MIT License (MIT)
Copyright (c) 2009-2017 Atollic AB

Permission is hereby granted, free of charge, to any person obtaining a copy
of this software and associated documentation files (the "Software"), to deal
in the Software without restriction, including without limitation the rights
to use, copy, modify, merge, publish, distribute, sublicense, and/or sell
copies of the Software, and to permit persons to whom the Software is
furnished to do so, subject to the following conditions:

The above copyright notice and this permission notice shall be included in all
copies or substantial portions of the Software.

THE SOFTWARE IS PROVIDED "AS IS", WITHOUT WARRANTY OF ANY KIND, EXPRESS OR
IMPLIED, INCLUDING BUT NOT LIMITED TO THE WARRANTIES OF MERCHANTABILITY,
FITNESS FOR A PARTICULAR PURPOSE AND NONINFRINGEMENT. IN NO EVENT SHALL THE
AUTHORS OR COPYRIGHT HOLDERS BE LIABLE FOR ANY CLAIM, DAMAGES OR OTHER
LIABILITY, WHETHER IN AN ACTION OF CONTRACT, TORT OR OTHERWISE, ARISING FROM,
OUT OF OR IN CONNECTION WITH THE SOFTWARE OR THE USE OR OTHER DEALINGS IN THE
SOFTWARE.

******************************************************************************
*/

/* Includes */
#include "stm32f4xx.h"
#include <mina_shield.h>
#include <stdio.h>
#include <nucleo_usart.h>

/* Private macro */
/* Private variables */
/* Private function prototypes */
/* Private functions */

volatile uint32_t _ticks = 0;

void SysTick_Handler(void)
{
  _ticks++;
}


/**
**===========================================================================
**
**  Abstract: main program
**
**===========================================================================
*/
int main(void)
{
  uint32_t tm2 = 0;

  /**
  *  IMPORTANT NOTE!
  *  The symbol VECT_TAB_SRAM needs to be defined when building the project
  *  if code has been located to RAM and interrupts are used. 
  *  Otherwise the interrupt table located in flash will be used.
  *  See also the <system_*.c> file and how the SystemInit() function updates 
  *  SCB->VTOR register.  
  *  E.g.  SCB->VTOR = 0x20000000;  
  */


  Usart2Init(0);

  // zrusit bufferovani vystupu i vstupu
  setvbuf(stdout, NULL, _IONBF, 0);
  setvbuf(stdin, NULL, _IONBF, 0);

  //Control LED
  Nucleo_SetPinGPIO(RGB_GREEN, ioPortOutputPP);

  // Enable clock to SysTick
  if (!(RCC->APB1ENR & RCC_APB1ENR_TIM3EN))
    {
      RCC->APB1ENR |= RCC_APB1ENR_TIM3EN;
      RCC->APB1RSTR |= RCC_APB1RSTR_TIM3RST;
      RCC->APB1RSTR &= ~RCC_APB1RSTR_TIM3RST;
    }

  SystemCoreClockUpdate();
  SysTick_Config(SystemCoreClock / 1000);



  char c = 'A';
  char buff [100];

  char znak = '1';
  Usart2Send(znak); // funkce interne pocka na doodvysilani

  sprintf(buff, "ahoj Peto!\n\r ...\n ...");
  Usart2String(buff);
  printf("Nazdar ...\n\r"); // Nutna uprava souboru syscalls.c
  printf("Pokus");

  /* Infinite loop */
  while (1)
  {
    if (_ticks >= tm2) // casovani vysilani
    {
      tm2 = _ticks + 500; // každých 100ms
      Usart2Send(c); // funkce interne pocka na doodvysilani
      c++;
      GPIOToggle(RGB_GREEN);

      if (c > 'Z') // vysilame jen velka pismena
        c = 'A';
    }

    if (IsUsart2Recv()) // neco prislo ?
	  {
		  char x = Usart2Recv(); // blokujici funkce
		  printf("%c", x);
	  }
  }
}
