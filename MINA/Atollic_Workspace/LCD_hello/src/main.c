/*
******************************************************************************
File:     main.c
Info:     Generated by Atollic TrueSTUDIO(R) 8.0.0   2017-10-02

The MIT License (MIT)
Copyright (c) 2009-2017 Atollic AB

Permission is hereby granted, free of charge, to any person obtaining a copy
of this software and associated documentation files (the "Software"), to deal
in the Software without restriction, including without limitation the rights
to use, copy, modify, merge, publish, distribute, sublicense, and/or sell
copies of the Software, and to permit persons to whom the Software is
furnished to do so, subject to the following conditions:

The above copyright notice and this permission notice shall be included in all
copies or substantial portions of the Software.

THE SOFTWARE IS PROVIDED "AS IS", WITHOUT WARRANTY OF ANY KIND, EXPRESS OR
IMPLIED, INCLUDING BUT NOT LIMITED TO THE WARRANTIES OF MERCHANTABILITY,
FITNESS FOR A PARTICULAR PURPOSE AND NONINFRINGEMENT. IN NO EVENT SHALL THE
AUTHORS OR COPYRIGHT HOLDERS BE LIABLE FOR ANY CLAIM, DAMAGES OR OTHER
LIABILITY, WHETHER IN AN ACTION OF CONTRACT, TORT OR OTHERWISE, ARISING FROM,
OUT OF OR IN CONNECTION WITH THE SOFTWARE OR THE USE OR OTHER DEALINGS IN THE
SOFTWARE.

******************************************************************************
*/

/* Includes */
#include "stm32f4xx.h"

/* Private macro */
/* Private variables */
/* Private function prototypes */
/* Private functions */

#include "nucleo_core.h"
#include "mbed_shield_lcd.h"        // include public functions

int main(void)
{
  // configure USART
  //Set TX and RX pins to AF
  Nucleo_SetPinGPIO(GPIOA, 2, ioPortAlternatePP);
  Nucleo_SetPinGPIO(GPIOA, 3, ioPortAlternatePP);

  Nucleo_SetPinAFGPIO(GPIOA, 2, 7);
  Nucleo_SetPinAFGPIO(GPIOA, 3, 7);

  // Enable Clock to USART2
  if (!(RCC->APB1ENR & RCC_APB1ENR_USART2EN)) // neni povolen USART2
  {
    RCC->APB1ENR |= RCC_APB1ENR_USART2EN;
    RCC->APB1RSTR |= RCC_APB1RSTR_USART2RST;
    RCC->APB1RSTR &= ~RCC_APB1RSTR_USART2RST;
  }

  USART2->CR1 = USART_CR1_RE | USART_CR1_TE; // staci povoleni prijmu a vysilani
  USART2->CR2 = 0; // nic specialniho
  USART2->CR3 = 0; // nic specialniho

  //TODO doplnit vypocet BRR podle pozadovaneho a podle clocku
  USART2->BRR = 0x1A1; // rychlost 38400 pri 16MHz - spocitano predem
  USART2->CR1 |= USART_CR1_UE; // az na zaver povolen blok USARTu


  // configure LCD display
  if (!MBED_LCD_init())             // check success
  {
    while(1)                        // defined stop when it fails
      ;
  }

  MBED_LCD_InitVideoRam(0x00);      // fill content with 0 = clear memory buffer

  char buf[128];
  sprintf(buf, "Disp: %02dx%02d pix", MBED_LCD_GetColumns(), MBED_LCD_GetRows());
  MBED_LCD_WriteStringXY(buf, 0, 2);    // example string output

  MBED_LCD_VideoRam2LCD();          // move changes in video buffer to LCD


  MBED_LCD_DrawCircle(80, 16, 8, true);     // sample drawing
  MBED_LCD_DrawCircle(96, 16, 12, true);

  MBED_LCD_VideoRam2LCD();         // move changes in video buffer to LCD

  while(1)
  {
    if (IsUsart2Recv()) // neco prislo ?
    {
      char x = Usart2Recv(); // blokujici funkce

      MBED_LCD_WriteStringXY(x, 0, 1);    // example string output

      MBED_LCD_VideoRam2LCD();          // move changes in video buffer to LCD


      MBED_LCD_DrawCircle(80, 16, 8, true);     // sample drawing
      MBED_LCD_DrawCircle(96, 16, 12, true);

      MBED_LCD_VideoRam2LCD();         // move changes in video buffer to LCD
    }
  }
}
